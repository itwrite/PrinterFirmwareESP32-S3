## main/Kconfig.projbuild
```kconfig
menu "IJPD Printer"

    comment "Wi-Fi credentials are configured through the SoftAP HTTP portal"
    comment "Connect to IJPD-Setup-XXXX, then open http://192.168.4.1"

endmenu
```
